## 手控制器/main/Kconfig.projbuild
```kconfig
menu "Camera telemetry uplink"
config HAND_CAMERA_SSID
    string "Camera hotspot SSID"
    default "Camera-D6A4"
config HAND_CAMERA_PASSWORD
    string "Camera hotspot password (empty for current open hotspot)"
    default ""
config HAND_CAMERA_HOST
    string "Camera IPv4 address"
    default "192.168.4.1"
config HAND_VOLTAGE_REFERENCE_MV
    int "Voltage calibration reference (mV)"
    range 1 6000
    default 1000
    help
        Known voltage for a one-point proportional calibration. The reported
        voltage is the divider reading times REFERENCE_MV / READING_MV.
        Equal values disable this additional gain correction.
config HAND_VOLTAGE_READING_MV
    int "Uncorrected divider reading at the reference voltage (mV)"
    range 1 10000
    default 1000
    help
        Use the reading before this gain correction, in the same supply
        condition as the reference. A single point does not verify other
        voltages or compensate for a change in the sampled supply source.
endmenu
```

## 手控制器/sdkconfig.defaults
```kconfig
CONFIG_IDF_TARGET="esp32s3"
CONFIG_ESPTOOLPY_FLASHSIZE_16MB=y
CONFIG_ESP_CONSOLE_USB_SERIAL_JTAG=y
CONFIG_LIBC_NEWLIB=y
CONFIG_SPI2_HOST=y
CONFIG_SCLK_GPIO=6
CONFIG_MOSI_GPIO=7
CONFIG_MISO_GPIO=8
CONFIG_CSN_GPIO=16
CONFIG_CE_GPIO=4
CONFIG_RADIO_CHANNEL=1
CONFIG_NRF24_SPI_CLOCK_HZ=500000
CONFIG_HAND_VOLTAGE_REFERENCE_MV=4140
CONFIG_HAND_VOLTAGE_READING_MV=5130
CONFIG_PARTITION_TABLE_CUSTOM=y
CONFIG_PARTITION_TABLE_CUSTOM_FILENAME="partitions.csv"
```

## 相机/sdkconfig.defaults
```kconfig
CONFIG_IDF_TARGET="esp32s3"
CONFIG_ESPTOOLPY_FLASHSIZE_8MB=y
CONFIG_ESP_DEFAULT_CPU_FREQ_MHZ_240=y
CONFIG_SPIRAM=y
CONFIG_SPIRAM_MODE_OCT=y
CONFIG_SPIRAM_SPEED_80M=y
CONFIG_SPIRAM_USE_MALLOC=y
CONFIG_SPIRAM_IGNORE_NOTFOUND=y
# CONFIG_CAMERA_PSRAM_DMA is not set
CONFIG_OV2640_SUPPORT=y
CONFIG_CAMERA_JPEG_MODE_FRAME_SIZE_CUSTOM=y
CONFIG_CAMERA_JPEG_MODE_FRAME_SIZE=163840
CONFIG_COMPILER_OPTIMIZATION_PERF=y
CONFIG_HTTPD_MAX_REQ_HDR_LEN=1024
CONFIG_HTTPD_MAX_URI_LEN=256
CONFIG_PARTITION_TABLE_SINGLE_APP_LARGE=y
CONFIG_ESP_MAIN_TASK_STACK_SIZE=6144

CONFIG_LWIP_TCP_SND_BUF_DEFAULT=11520

CONFIG_LWIP_TCP_WND_DEFAULT=32768

CONFIG_CAMERA_CORE1=y
CONFIG_HTTPD_WS_SUPPORT=y
CONFIG_HTTPD_WS_POST_HANDSHAKE_CB_SUPPORT=y
CONFIG_LWIP_MAX_SOCKETS=16
```
